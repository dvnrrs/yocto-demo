## meta-demo/conf/layer.conf
```bitbake
# We have a conf and classes directory, add to BBPATH
BBPATH =. "${LAYERDIR}:"

# We have recipes-* directories, add to BBFILES
BBFILES += "${LAYERDIR}/recipes-*/*/*.bb \
            ${LAYERDIR}/recipes-*/*/*.bbappend"

BBFILE_COLLECTIONS += "demo"
BBFILE_PATTERN_demo = "^${LAYERDIR}/"
BBFILE_PRIORITY_demo = "5"

LAYERSERIES_COMPAT_demo = "kirkstone"

# This should only be incremented on significant changes that will
# cause compatibility issues with other layers
LAYERVERSION_demo = "3"

LAYERDEPENDS_demo = "core"

REQUIRED_POKY_BBLAYERS_CONF_VERSION = "2"
```
